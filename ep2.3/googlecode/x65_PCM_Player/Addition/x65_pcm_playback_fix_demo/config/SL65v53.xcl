-carm

//Тело патча
-Z(CODE)START,CODE,PATCH_BODY,INITTAB=A0CF0000-FFFFFFFF
-Z(CODE)DATA_Z=A87898D8-A8789948

//Список врезок
-Z(CODE)PATCH_SKIP_CHECK_SAMPLE_RATE1=A1181D4C-FFFFFFFF // + 
-Z(CODE)PATCH_SKIP_CHECK_SAMPLE_RATE2=A119D8D4-FFFFFFFF // +

-Z(CODE)PATCH_DAC_SAMPLE_RATE_SET_HOOK=A123FC2C-FFFFFFFF // +
-Z(CODE)PATCH_STEREOCONTROL=A123FF18-FFFFFFFF // +

-Z(CODE)PATCH_CLEAR_RAM_FRAME_FIX=A119D398-FFFFFFFF // +
-Z(CODE)PATCH_CLEAR_DSP_FRAME_FIX=A119D3CC-FFFFFFFF // +

-Z(CODE)PATCH_CHANGE_PCM_HOOK_POINTER=A119DA44-FFFFFFFF // +
-Z(CODE)PATCH_FRAME_SIZE_FIX_HOOK=A119D4A0-FFFFFFFF // +
-Z(CODE)PATCH_PCM_COPY_FRAME_H=A119D2FC-FFFFFFFF // +

-Z(CODE)PATCH_OLD_AUDIOHOOK=A119985C-FFFFFFFF // +

//Список локальных переходов
-Z(CODE)PATCH_JUMP=A123FC58-FFFFFFFF //PATCH_DAC_SAMPLE_RATE_SET_HOOK + 0x2C
