-carm

//Тело патча
-Z(CODE)START,CODE,PATCH_BODY=A0FAB9C0-A0FABFA0

//Список врезок
-Z(CODE)PATCH_VREZKA_01=A096CAC8-FFFFFFFF //+
-Z(CODE)PATCH_VREZKA_02=A0967B9C-FFFFFFFF //+
-Z(CODE)PATCH_VREZKA_03=A08D63C0-FFFFFFFF //+
-Z(CODE)PATCH_VREZKA_04=A08D699C-FFFFFFFF //+
-Z(CODE)PATCH_VREZKA_05=A0967C14-FFFFFFFF //+
-Z(CODE)PATCH_VREZKA_06=A0A8DB18-FFFFFFFF //+
-Z(CODE)PATCH_VREZKA_07=A096C574-FFFFFFFF //+
-Z(CODE)PATCH_VREZKA_08=A096C6E8-FFFFFFFF //+
-Z(CODE)PATCH_VREZKA_09=A096CB20-FFFFFFFF //+
-Z(CODE)PATCH_VREZKA_10=A096C6D0-FFFFFFFF //+
-Z(CODE)PATCH_VREZKA_11=A0A8D238-FFFFFFFF //+
-Z(CODE)PATCH_VREZKA_12=A0A8D9D0-FFFFFFFF //+
-Z(CODE)PATCH_VREZKA_13=A0A8DE04-FFFFFFFF //+
-Z(CODE)PATCH_VREZKA_14=A0A8D988-FFFFFFFF //+

-Z(CODE)PATCH_VREZKA_15=A0967644-FFFFFFFF //+

//Список локальных переходов
-Z(CODE)PATCH_JUMP_01=A0A8DB44-FFFFFFFF //PATCH_VREZKA_06 + 0x2C
-Z(CODE)PATCH_JUMP_02=A096CB64-FFFFFFFF //PATCH_VREZKA_09 + 0x44
-Z(CODE)PATCH_JUMP_03=A0A8D260-FFFFFFFF //PATCH_VREZKA_11 + 0x28
-Z(CODE)PATCH_JUMP_04=A0A8DA08-FFFFFFFF //PATCH_VREZKA_14 + 0x80