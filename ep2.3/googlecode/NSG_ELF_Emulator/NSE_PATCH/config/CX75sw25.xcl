-carm
-Z(CODE)PATCH_BODY,CODE,DATA_I,DATA_C,DATA_Z,INITTAB=A0FC5000-FFFFFFFF

-Z(CODE)PATCH_NSGCSMFINDER=A07F683C-FFFFFFFF
-Z(CODE)PATCH_ONKEY_HOOK=A0803A10-FFFFFFFF
-Z(CODE)PATCH_ONMESSAGE_HOOK=A07F69A8-FFFFFFFF
