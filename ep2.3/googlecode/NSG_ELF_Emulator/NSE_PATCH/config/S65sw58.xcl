-carm
-Z(CODE)PATCH_BODY,CODE,DATA_I,DATA_C,DATA_Z,INITTAB=A0FC5000-FFFFFFFF

-Z(CODE)PATCH_NSGCSMFINDER=A114EFF0-FFFFFFFF
-Z(CODE)PATCH_ONKEY_HOOK=A115B950-FFFFFFFF
-Z(CODE)PATCH_ONMESSAGE_HOOK=A114F138-FFFFFFFF
