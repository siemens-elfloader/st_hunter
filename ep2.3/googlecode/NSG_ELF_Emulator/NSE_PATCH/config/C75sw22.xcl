-carm
-Z(CODE)PATCH_BODY,CODE,DATA_I,DATA_C,DATA_Z,INITTAB=A0F10000-FFFFFFFF

-Z(CODE)PATCH_NSGCSMFINDER=A07A5D80-FFFFFFFF
-Z(CODE)PATCH_ONKEY_HOOK=A07B2F54-FFFFFFFF
-Z(CODE)PATCH_ONMESSAGE_HOOK=A07A5EEC-FFFFFFFF
