-carm
-Z(CODE)PATCH_BODY,CODE,DATA_I,DATA_C,DATA_Z,INITTAB=A0FC5000-FFFFFFFF

-Z(CODE)PATCH_NSGCSMFINDER=A1146E88-FFFFFFFF
-Z(CODE)PATCH_ONKEY_HOOK=A11537F8-FFFFFFFF
-Z(CODE)PATCH_ONMESSAGE_HOOK=A1146FD0-FFFFFFFF
