-carm
-Z(CODE)CODE,CODE_X,DATA_C=A1560000-FFFFFFFF

-Z(CODE)HOOK_DUMP=A03F4FDC-FFFFFFFF //3700380039003E003A003B003C003D003F00FFFF+14
-Z(CODE)RecordWindow=A050A7FC-FFFFFFFF //201C????????0122281C0C30
-Z(CODE)Callinwindow=A02E9330-FFFFFFFF //FFF7??FC002803D00321201C
-Z(CODE)CallOutWindow=A02E8D34-FFFFFFFF //6946????????03226946??-4
-Z(CODE)AddrBookWindow=A0575C84-FFFFFFFF //0100A0E3000085E50400A0E182DF8DE2
-Z(CODE)AddrBookWindow2=A0575C6C-FFFFFFFF //010080E2400BC0E3??????FA
-Z(CODE)PHONEBOOKHOOK=A057A7C4-FFFFFFFF //04 10 A0 E106 00 A0 E1????????03 30 A0 E300 20 A0 E3+C

-Z(CODE)SMS_IN_HOOK=A0846834-FFFFFFFF //0298????????3690502811D1B04AB149



-Z(CODE)NUM_SELECT_MENU_HDR_ICON=A0823C9C-FFFFFFFF //8B376162656469747669657773F70000+18
-Z(CODE)NUM_SELECT_MENU_LINES=A0823CD4-FFFFFFFF //8B376162656469747669657773F70000+50
-Z(CODE)NUM_SELECT_MENU_ALITEM=A0579060-FFFFFFFF //FA00A0A0E1040096E5-3
-Z(CODE)NUM_SELECT_MENU_TEXT=A0579134-FFFFFFFF //FB81DF8DE2F085BDE8-3
-Z(CODE)NUM_SELECT_MENU_GUI=A0578EDC-FFFFFFFF //FB0040A0E130139FE5-3


-Z(CODE)EDIAL_CREATE_HOOK=A02E7560-FFFFFFFF
-Z(CODE)EDIAL_REDRAW_HOOK=A02E73D4-FFFFFFFF
-Z(CODE)EDIAL_ATTR_HOOK=A02E753E-FFFFFFFF

-Z(CODE)ADRBKLST_ALLOCWS_HOOK=A056FB58-FFFFFFFF
-Z(CODE)ADRBKLST_CATWS_HOOK=A056FC28-FFFFFFFF
-Z(CODE)ADRBKLST_ALLOCWS_HOOK2=A056F688-FFFFFFFF
-Z(CODE)ADRBKLST_CATWS_HOOK2=A056F6F4-FFFFFFFF
-Z(CODE)ADRBKLST_LINES_HOOK1=A0825634-FFFFFFFF
-Z(CODE)ADRBKLST_LINES_HOOK2=A08261F0-FFFFFFFF
-Z(CODE)ADRBKLST_LINES_HOOK3=A0825664-FFFFFFFF
-Z(CODE)ADRBKLST_SIMALLWS_HOOK=A058B510-FFFFFFFF
-Z(CODE)ADRBKLST_SIMNUMWS_HOOK=A058B564-FFFFFFFF
-Z(CODE)ADRBKLST_ALLOCWS_HOOK3=A056FEAC-FFFFFFFF
-Z(CODE)ADRBKLST_CATWS_HOOK3=A056FF48-FFFFFFFF
