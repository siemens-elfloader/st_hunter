-carm
-Z(CODE)START,CODE,SWITAB,INITTAB,DATA_ID,DATA_C,CONFIG_DATA_ID=A0FD8000-A0FDA000
-Z(DATA)CONFIG_DATA_I,DATA_N=A848C98C-A848D108 //*(30402de944d04de2-10),*(D0C10000120200000-8)-4

-Z(CODE)PATCH_ONCREATE=A0466CA0-A0466CA3
-Z(CODE)PATCH_ONCLOSE=A0466CA4-A0466CA7	
-Z(CODE)PATCH_ESI=A07383A4-FFFFFFFF

-Z(CODE)PATCH_NO_UNK_EXT=A029F188-FFFFFFFF 

-Z(CODE)SWILIB_FUNC00B=A0FD402C-A0FD402F
-Z(CODE)SWILIB_FUNC00C=A0FD4030-A0FD4033
-Z(CODE)SWILIB_FUNC095=A0FD4254-A0FD4257
-Z(CODE)SWILIB_FUNC12B_12D=A0FD44AC-A0FD44B7
-Z(CODE)SWILIB_FUNC171=A0FD45C4-A0FD45C7
-Z(CODE)SWILIB_FUNC172=A0FD45C8-A0FD45CB
-Z(CODE)SWILIB_FUNC19C=A0FD4670-A0FD4673
-Z(CODE)SWILIB_FUNC1B8_1BB=A0FD46E0-A0FD46EF
-Z(CODE)SWILIB_FUNC1E9=A0FD47A4-A0FD47A7

-Z(DATA)REGEXPL_CNT=A848C988-A848C98B
-Z(CODE)REG_FILE=A029F780-A029F787

-Z(CODE)PATCH_GET_EXT=A029F158-A029F15B        
-Z(CODE)PATCH_GET_REGEXT1=A029EF68-A029EF6B	
-Z(CODE)PATCH_GET_REGEXT2=A029EF7C-A029EF7F	
-Z(CODE)PATCH_BIG_ICON=A0341330-A0341333
-Z(CODE)PATCH_REGEXPL=A029F868-A029F86B

-Z(CODE)PATCH_GET_PIT=A00DF780-A00DF783
-Z(CODE)PATCH_GET_PITJ=A00DF784-A00DF787

-Z(CODE)PATCH_KEYB_MSG=A00F3D78-A00F3D7B
-Z(CODE)PATCH_KEYB_MSGJ=A00F3D7C-A00F3D7F

-Z(CODE)FSWI_PATCH1=A0188DF0-A0188DF3
-Z(CODE)FSWI_PATCH2=A0188ED4-A0188ED7	
-Z(CODE)FSWI_PATCH3=A0188ED3-A0188ED4	
-Z(CODE)LIBR=A0FD4000-A0FD7FFF