-carm
-Z(CODE)START,CODE,DATA_C=A0FDB000-A0FDBA00

-Z(CODE)PATCH_MAINENTER=A12C50EC-FFFFFFFF

//browser
-Z(CODE)PATCH_BROWSER_ENTER1=A0B6F88C-FFFFFFFF
-Z(CODE)PATCH_BROWSER_ENTER2=A0B6F898-FFFFFFFF //Must be a multiple of 4m! (0, 4, 8, C)
//java
-Z(CODE)PATCH_JAVA_BEARER=A114EB48-FFFFFFFF

