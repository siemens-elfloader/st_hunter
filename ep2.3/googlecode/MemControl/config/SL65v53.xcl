-carm
-Z(CODE)START,CODE,DATA_C=A0FDB000-A0FDBA00

-Z(CODE)PATCH_MAINENTER=A1295F64-FFFFFFFF

//browser
-Z(CODE)PATCH_BROWSER_ENTER1=A0B3F398-FFFFFFFF
-Z(CODE)PATCH_BROWSER_ENTER2=A0B3F3A4-FFFFFFFF //Must be a multiple of 4m! (0, 4, 8, C)
//java
-Z(CODE)PATCH_JAVA_BEARER=A11469E0-FFFFFFFF