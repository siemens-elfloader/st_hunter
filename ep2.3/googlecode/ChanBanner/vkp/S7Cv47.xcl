-carm
-Z(CODE)PATCH_GLOBAL_SCAN=A0E6F5E6-A0E6F5F3
-Z(CODE)PATCH_J=A0E6F5F4-A0E6F5FB
-Z(CODE)PATCH_WORK_SCAN=A0AEB66E-A0AEB671  A0E6FC22-A0E6FC25
-Z(CODE)CODE=A0079C00-A0079FFF
-Z(DATA)RXLVLS=A8E5591E-A8E55CEA