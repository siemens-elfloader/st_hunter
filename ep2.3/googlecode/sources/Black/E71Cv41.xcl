-carm
-Z(CODE)BLACK_LIST_BODY,CODE,DATA_C,ICODE,INITTAB,INTVEC,IRQ_STACK,CSTACK=A1359A00-FFFFFFFF
-Z(CODE)BLACKLIST_DUMP=A08511F4-FFFFFFFF
-Z(CODE)RHOOKBLACKLIST=A071DC0E-FFFFFFFF
//-Z(CODE)NONAMEHOOK=A09DBC14-FFFFFFFF