-carm
-Z(CODE)BLACK_LIST_BODY,CODE,DATA_C,ICODE,INITTAB,INTVEC,IRQ_STACK,CSTACK=A153A000-FFFFFFFF
-Z(CODE)BLACKLIST_DUMP=A06AFF1C-FFFFFFFF
-Z(CODE)RHOOKBLACKLIST=A0359736-FFFFFFFF
//-Z(CODE)NONAMEHOOK=A09DBC14-FFFFFFFF