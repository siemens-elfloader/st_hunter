-carm
-Z(CODE)CODE,DATA_C,CONFIG_DATA_C=A0FC7D00-FFFFFFFF

-Z(CODE)PATCH_ENTER1=A048DB44-A048DB4B
-Z(CODE)PATCH_ENTER1=A05A9B44-A05A9B4B

-Z(CODE)PATCH_ENTER2=A04564DC-A04564DC3

-Z(CODE)PATCH_ENTER3=A0B40464-A0B40467
